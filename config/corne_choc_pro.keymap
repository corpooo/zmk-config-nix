#define CONFIG_WIRELESS

#define ZMK_BASE_LAYER(name, LT, RT, LM, RM, LB, RB, LH, RH)                   \
    ZMK_LAYER(                                                                 \
        name,                                                                  \
                 LT &none &none RT                                             \
                 LM &none &none RM                                             \
                 LB             RB                                             \
                 LH             RH                                             \
    )

#include "key-labels/corne-choc-bt-pro.h"
#include "base.keymap"

/ { chosen { zmk,physical-layout = &five_col_layout; }; };

/* vim: set ft=cpp tw=146: */
